## build/Kconfig/Kconfig.shield.defconfig
```kconfig
osource "/home/seatech/Documents/ProjetIOT/sniot_zephyr_template/boards/shields/*/Kconfig.defconfig"
```

## build/Kconfig/arch/Kconfig
```kconfig
# Load Zephyr Arch Kconfig descriptions.
osource "/home/seatech/Documents/ProjetIOT/zephyr/arch/rx/Kconfig"
osource "/home/seatech/Documents/ProjetIOT/zephyr/arch/x86/Kconfig"
osource "/home/seatech/Documents/ProjetIOT/zephyr/arch/xtensa/Kconfig"
osource "/home/seatech/Documents/ProjetIOT/zephyr/arch/sparc/Kconfig"
osource "/home/seatech/Documents/ProjetIOT/zephyr/arch/riscv/Kconfig"
osource "/home/seatech/Documents/ProjetIOT/zephyr/arch/posix/Kconfig"
osource "/home/seatech/Documents/ProjetIOT/zephyr/arch/mips/Kconfig"
osource "/home/seatech/Documents/ProjetIOT/zephyr/arch/arm64/Kconfig"
osource "/home/seatech/Documents/ProjetIOT/zephyr/arch/arm/Kconfig"
osource "/home/seatech/Documents/ProjetIOT/zephyr/arch/arc/Kconfig"
```

## build/Kconfig/boards/Kconfig.defconfig
```kconfig
# Load Zephyr board defconfig descriptions.
osource "/home/seatech/Documents/ProjetIOT/zephyr/boards/espressif/esp32_devkitc/Kconfig.defconfig"
```

## build/Kconfig/boards/Kconfig.esp32_devkitc
```kconfig
# Load board Kconfig descriptions.
osource "/home/seatech/Documents/ProjetIOT/zephyr/boards/espressif/esp32_devkitc/Kconfig.esp32_devkitc"
```

## build/Kconfig/boards/Kconfig.sysbuild
```kconfig
# Load Sysbuild board Kconfig descriptions.
osource "/home/seatech/Documents/ProjetIOT/zephyr/boards/espressif/esp32_devkitc/Kconfig.sysbuild"
```
